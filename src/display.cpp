#include "display.h"
#include "config.h"
#include <Wire.h>
#include <Adafruit_LEDBackpack.h>

static Adafruit_8x8matrix mats[3];
static const uint8_t ADDRS[3] = {
  HT16K33_ADDR_LEFT, HT16K33_ADDR_MID, HT16K33_ADDR_RIGHT
};

// 5x7 ASCII 32..90 (space to Z). Lowercase mapped to uppercase.
static const uint8_t FONT5X7[][5] PROGMEM = {
  {0x00,0x00,0x00,0x00,0x00}, // space
  {0x00,0x00,0x5F,0x00,0x00}, // !
  {0x00,0x07,0x00,0x07,0x00}, // "
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  {0x61,0x51,0x49,0x45,0x43}, // Z
};

static String scrollText;
static int scrollX = 0;
static int scrollWidth = 0;
static bool scrolling = false;
static uint32_t lastScrollMs = 0;

static char normChar(char c) {
  if (c >= 'a' && c <= 'z') c = c - 'a' + 'A';
  if (c == 0xA3) return '$';
  return c;
}

static void drawPixel24(int x, int y, bool on) {
  if (x < 0 || x >= DISPLAY_WIDTH || y < 0 || y >= DISPLAY_HEIGHT) return;
  int m = x / 8;
  int lx = x % 8;
  mats[m].drawPixel(lx, y, on ? LED_ON : LED_OFF);
}

static void drawCharAt(int x, char c) {
  c = normChar(c);
  int idx = (int)c - 32;
  if (idx < 0 || idx > 58) idx = 0;
  for (int col = 0; col < 5; col++) {
    uint8_t bits = pgm_read_byte(&FONT5X7[idx][col]);
    for (int row = 0; row < 7; row++) {
      drawPixel24(x + col, row + 1, bits & (1 << row));
    }
  }
}

static int textPixelWidth(const String& s) {
  if (s.length() == 0) return 0;
  return (int)s.length() * 6 - 1;
}

static void blitText(const String& s, int originX) {
  for (int i = 0; i < 3; i++) mats[i].clear();
  int x = originX;
  for (size_t i = 0; i < s.length(); i++) {
    drawCharAt(x, s[i]);
    x += 6;
  }
  for (int i = 0; i < 3; i++) mats[i].writeDisplay();
}

bool displayBegin() {
  Wire.begin(I2C_SDA_PIN, I2C_SCL_PIN, I2C_FREQ_HZ);
  bool ok = true;
  for (int i = 0; i < 3; i++) {
    if (!mats[i].begin(ADDRS[i])) {
      Serial.printf("HT16K33 0x%02X not found\n", ADDRS[i]);
      ok = false;
    } else {
      mats[i].setBrightness(DISPLAY_BRIGHTNESS);
      mats[i].clear();
      mats[i].writeDisplay();
    }
  }
  return ok;
}

void displayClear() {
  scrolling = false;
  for (int i = 0; i < 3; i++) {
    mats[i].clear();
    mats[i].writeDisplay();
  }
}

void displaySetBrightness(uint8_t level) {
  if (level > 15) level = 15;
  for (int i = 0; i < 3; i++) mats[i].setBrightness(level);
}

void displayShowText(const String& text) {
  scrolling = false;
  int w = textPixelWidth(text);
  int origin = 0;
  if (w < DISPLAY_WIDTH) origin = (DISPLAY_WIDTH - w) / 2;
  blitText(text, origin);
}

void displaySetScroll(const String& text) {
  scrollText = text;
  scrollWidth = textPixelWidth(text);
  if (scrollWidth <= DISPLAY_WIDTH) {
    displayShowText(text);
    return;
  }
  scrolling = true;
  scrollX = DISPLAY_WIDTH;
  lastScrollMs = millis();
  blitText(scrollText, scrollX);
}

bool displayIsScrolling() { return scrolling; }

void displayTick() {
  if (!scrolling) return;
  uint32_t now = millis();
  if (now - lastScrollMs < SCROLL_MS) return;
  lastScrollMs = now;
  scrollX--;
  if (scrollX < -scrollWidth) scrollX = DISPLAY_WIDTH;
  blitText(scrollText, scrollX);
}

void displayWelcome() {
  displayShowText("XRPL");
}

void displayStatus(const String& line) {
  if (textPixelWidth(line) > DISPLAY_WIDTH) displaySetScroll(line);
  else displayShowText(line);
}
